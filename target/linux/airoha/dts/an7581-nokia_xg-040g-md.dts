// SPDX-License-Identifier: GPL-2.0-only OR MIT

#include "an7581-nokia_xg-040g-md-common.dtsi"
#include "an758x-nokia_xg-040g-stock-parts.dtsi"

/ {
	model = "Nokia Bell XG-040G-MD";
	compatible = "bell,xg-040g-md", "airoha,an7581";
};